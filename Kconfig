## components/pstar_storage_hal/Kconfig
```kconfig
# components/pstar_storage_hal/Kconfig
menu "Project Star Storage HAL Configuration"

    config PSTAR_KCONFIG_STORAGE_HAL_ENABLED
        bool "Enable Storage HAL Component"
        default y
        help
            Enable the Project Star Storage Hardware Abstraction Layer component,
            which provides a unified interface for storage devices. Disabling this
            component will disable all storage-related functionality.

    config PSTAR_KCONFIG_SD_CARD_ENABLED
        bool "Enable SD Card Hardware Support"
        depends on PSTAR_KCONFIG_STORAGE_HAL_ENABLED
        default y
        help
            Enable SD card hardware support in the storage HAL. Disabling this will
            disable all SD card related functionality throughout the system.

    menu "SD Card Interface Configuration"
        depends on PSTAR_KCONFIG_SD_CARD_ENABLED

        config PSTAR_KCONFIG_SD_CARD_SPI_MODE_ENABLED
            bool "Enable SPI Interface Mode"
            default y
            select PSTAR_KCONFIG_BUS_SPI_ENABLED if PSTAR_KCONFIG_BUS_COMPONENT_ENABLED
            help
                Allow the use of the SPI interface for SD cards.
                This enables the SPI bus type in the Bus Component.

        config PSTAR_KCONFIG_SD_CARD_SDIO_MODE_ENABLED
            bool "Enable SDIO Interface Mode (Placeholder - Not Currently Supported)"
            default n
            help
                This option is reserved for future SDIO support and currently has no effect.
                The SDIO implementation will be added in a future update.

        config PSTAR_KCONFIG_SD_CARD_4BIT_MODE
            bool "Use 4-bit SD bus width (Reserved for Future SDIO Support)"
            default n
            depends on PSTAR_KCONFIG_SD_CARD_SDIO_MODE_ENABLED
            help
                This option is reserved for future SDIO support and currently has no effect.
                In SPI mode, only 1-bit communication is possible regardless of this setting.

        choice PSTAR_KCONFIG_SD_CARD_PREFERRED_INTERFACE
            prompt "Preferred SD Card Interface"
            default PSTAR_KCONFIG_SD_CARD_INTERFACE_SPI
            help
                Select the interface to try first when initializing the SD card.
                Currently, only SPI mode is supported.

            config PSTAR_KCONFIG_SD_CARD_INTERFACE_SPI
                bool "SPI (Currently the only supported interface)"

            config PSTAR_KCONFIG_SD_CARD_INTERFACE_SDIO
                bool "SDIO (Placeholder - Not Currently Supported)"
                depends on PSTAR_KCONFIG_SD_CARD_SDIO_MODE_ENABLED
        endchoice

        config PSTAR_KCONFIG_SD_CARD_ENABLE_INTERFACE_FALLBACK
            bool "Enable Interface Fallback (Reserved for Future Multi-Interface Support)"
            default n
            help
                This option is reserved for future multi-interface support and currently has no effect.
                Since only SPI is currently supported, there is no fallback option available.
    endmenu

    menu "SD Card Configuration"
        depends on PSTAR_KCONFIG_STORAGE_HAL_ENABLED && PSTAR_KCONFIG_SD_CARD_ENABLED

        config PSTAR_KCONFIG_SD_CARD_DETECTION_ENABLED
            bool "Enable SD Card Detection"
            default y
            help
                Enable hardware detection of SD card insertion/removal.

        config PSTAR_KCONFIG_SD_CARD_DETECTION_ACTIVE_LOW
            bool "Card detect pin is low-active"
            depends on PSTAR_KCONFIG_SD_CARD_DETECTION_ENABLED
            default n
            help
                If enabled, card detect pin is low-active (0=card present).
                If disabled, card detect pin is high-active (1=card present).

        config PSTAR_KCONFIG_SD_CARD_MAX_RETRY
            int "Maximum mount retries"
            range 1 10
            default 3
            help
                Maximum number of retry attempts when mounting the SD card.

        config PSTAR_KCONFIG_SD_CARD_RETRY_DELAY_MS
            int "Retry delay (ms)"
            range 100 5000
            default 1000
            help
                Delay between retry attempts in milliseconds.

        config PSTAR_KCONFIG_SD_CARD_MAX_RETRY_DELAY_MS
            int "Maximum retry delay (ms)"
            range 1000 30000
            default 5000
            help
                Maximum delay between retry attempts in milliseconds.

        config PSTAR_KCONFIG_SD_CARD_DEBOUNCE_MS
            int "Card detection debounce time (ms)"
            depends on PSTAR_KCONFIG_SD_CARD_DETECTION_ENABLED
            range 10 1000
            default 100
            help
                Debounce time in milliseconds for SD card detection.

        config PSTAR_KCONFIG_SD_CARD_MUTEX_TIMEOUT_MS
            int "SD card mutex timeout (ms)"
            range 100 5000
            default 500
            help
                Timeout in milliseconds for acquiring the SD card mutex.

        config PSTAR_KCONFIG_SD_CARD_TASK_STACK_SIZE
            int "SD card task stack size"
            range 2048 8192
            default 4096
            help
                Stack size for the SD card mount task.

        config PSTAR_KCONFIG_SD_CARD_TASK_PRIORITY
            int "SD card task priority"
            range 1 24
            default 5
            help
                FreeRTOS priority for the SD card mount task.

        config PSTAR_KCONFIG_SD_CARD_MAX_PATH_LENGTH
            int "Maximum SD card path length"
            range 64 512
            default 128
            help
                Maximum length for SD card file paths.
    endmenu

    menu "SD Card Pin Configuration"
        depends on PSTAR_KCONFIG_SD_CARD_ENABLED

        config PSTAR_KCONFIG_SD_CARD_DET_GPIO
            int "Card detect GPIO pin"
            default 13
            depends on PSTAR_KCONFIG_SD_CARD_DETECTION_ENABLED
            range 0 39
            help
                GPIO pin number for SD card detection.

        menu "SPI Interface Pins"
            depends on PSTAR_KCONFIG_SD_CARD_SPI_MODE_ENABLED

            config PSTAR_KCONFIG_SD_CARD_SPI_CS_GPIO
                int "SPI Chip Select (CS) GPIO Pin"
                range 0 39
                default 5
                help
                    GPIO pin number for SPI Chip Select (CS/SS).
                    Corresponding Kconfig Macro: CONFIG_PSTAR_KCONFIG_SD_CARD_SPI_CS_GPIO

            # --- FIX: Renamed DO to DI (MOSI) ---
            config PSTAR_KCONFIG_SD_CARD_SPI_DI_GPIO
                int "SPI DI (MOSI) GPIO Pin"
                range 0 39
                default 15
                help
                    GPIO pin for SPI DI (Data In / Master Out Slave In).
                    Corresponding Kconfig Macro: CONFIG_PSTAR_KCONFIG_SD_CARD_SPI_DI_GPIO

            # --- FIX: Renamed DI to DO (MISO) ---
            config PSTAR_KCONFIG_SD_CARD_SPI_DO_GPIO
                int "SPI DO (MISO) GPIO Pin"
                range 0 39
                default 2
                help
                    GPIO pin for SPI DO (Data Out / Master In Slave Out).
                    Corresponding Kconfig Macro: CONFIG_PSTAR_KCONFIG_SD_CARD_SPI_DO_GPIO

            config PSTAR_KCONFIG_SD_CARD_SPI_CLK_GPIO
                int "SPI CLK GPIO Pin"
                range 0 39
                default 14
                help
                    GPIO pin for SPI Clock (SCLK).
                    Corresponding Kconfig Macro: CONFIG_PSTAR_KCONFIG_SD_CARD_SPI_CLK_GPIO
        endmenu

        menu "SDIO Interface Pins (Reserved for Future Implementation)"
            depends on PSTAR_KCONFIG_SD_CARD_SDIO_MODE_ENABLED

            config PSTAR_KCONFIG_SD_CARD_SDIO_CLK_GPIO
                int "SDIO CLK GPIO pin (Not Currently Used)"
                range 0 39
                default 14
                help
                    Reserved for future SDIO implementation.

            config PSTAR_KCONFIG_SD_CARD_SDIO_CMD_GPIO
                int "SDIO CMD GPIO pin (Not Currently Used)"
                range 0 39
                default 15
                help
                    Reserved for future SDIO implementation.

            config PSTAR_KCONFIG_SD_CARD_SDIO_D0_GPIO
                int "SDIO D0 GPIO pin (Not Currently Used)"
                range 0 39
                default 2
                help
                    Reserved for future SDIO implementation.

            config PSTAR_KCONFIG_SD_CARD_SDIO_D1_GPIO
                int "SDIO D1 GPIO pin (4-bit mode) (Not Currently Used)"
                depends on PSTAR_KCONFIG_SD_CARD_4BIT_MODE
                range 0 39
                default 4
                help
                    Reserved for future SDIO implementation.

            config PSTAR_KCONFIG_SD_CARD_SDIO_D2_GPIO
                int "SDIO D2 GPIO pin (4-bit mode) (Not Currently Used)"
                depends on PSTAR_KCONFIG_SD_CARD_4BIT_MODE
                range 0 39
                default 12
                help
                    Reserved for future SDIO implementation.

            config PSTAR_KCONFIG_SD_CARD_SDIO_D3_GPIO
                int "SDIO D3 GPIO pin (4-bit mode) (Not Currently Used)"
                depends on PSTAR_KCONFIG_SD_CARD_4BIT_MODE
                range 0 39
                default 32
                help
                    Reserved for future SDIO implementation.
        endmenu

    endmenu # SD Card Pin Configuration

    menu "SD Card Bus Name Configuration"
        depends on PSTAR_KCONFIG_SD_CARD_ENABLED

        config PSTAR_KCONFIG_SD_CARD_GPIO_BUS_NAME
            string "SD card GPIO bus name"
            default "sd_card_gpio"
            help
                Name of the GPIO bus used for SD card.

        config PSTAR_KCONFIG_SD_CARD_SPI_BUS_NAME
            string "SD card SPI bus name"
            depends on PSTAR_KCONFIG_SD_CARD_SPI_MODE_ENABLED
            default "sd_card_spi"
            help
                Name of the SPI bus used for SD card.

        config PSTAR_KCONFIG_SD_CARD_SDIO_BUS_NAME
            string "SD card SDIO bus name (Reserved for Future Implementation)"
            depends on PSTAR_KCONFIG_SD_CARD_SDIO_MODE_ENABLED
            default "sd_card_sdio"
            help
                Reserved for future SDIO implementation.
    endmenu

    menu "SD Card NVS Configuration"
        depends on PSTAR_KCONFIG_SD_CARD_ENABLED

        config PSTAR_KCONFIG_SD_CARD_NVS_NAMESPACE
            string "SD card NVS namespace"
            default "sd_card"
            help
                NVS namespace used for storing SD card configuration.

        config PSTAR_KCONFIG_SD_CARD_NVS_INTERFACE_KEY
            string "NVS key for interface setting"
            default "interface"
            help
                NVS key used to store the SD card interface configuration.

        config PSTAR_KCONFIG_SD_CARD_NVS_BUS_WIDTH_KEY
            string "NVS key for bus width setting"
            default "bus_width"
            help
                NVS key used to store the SD card bus width configuration.
    endmenu

    menu "Filesystem Configuration"
        depends on PSTAR_KCONFIG_SD_CARD_ENABLED

        config PSTAR_KCONFIG_SD_CARD_MOUNT_POINT
            string "SD card mount point"
            default "/sdcard"
            help
                Mount point for the SD card in the filesystem.

        config PSTAR_KCONFIG_SD_CARD_MAX_FILES
            int "Maximum open files"
            range 1 20
            default 5
            help
                Maximum number of files that can be open simultaneously.

        config PSTAR_KCONFIG_SD_CARD_ALLOCATION_UNIT_SIZE
            int "Filesystem allocation unit size"
            range 512 65536
            default 16384
            help
                Allocation unit size for the filesystem in bytes.
                Larger values may improve performance but waste space.
    endmenu

endmenu
```

## sdkconfig.defaults
```kconfig
CONFIG_PSTAR_KCONFIG_PIN_VALIDATOR_ENABLED=y

# SD Card Configuration
# Uncomment the line below to disable SD card support completely
# CONFIG_PSTAR_KCONFIG_SD_CARD_ENABLED=n

# Logging Configuration
# Even when SD card is disabled, you can still keep SD logging enabled
# The system will gracefully fall back to console-only logging
CONFIG_PSTAR_KCONFIG_LOGGING_ENABLED=y
CONFIG_PSTAR_KCONFIG_LOGGING_CONSOLE_ENABLED=y
```
