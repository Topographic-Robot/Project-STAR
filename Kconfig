## Kconfig
```kconfig
# Kconfig

# Include project-level configuration (if any)
source "main/Kconfig.projbuild"

# Include component Kconfig files to define all your custom symbols
source "components/pstar_logger/Kconfig.Kconfig"
source "components/pstar_bus/Kconfig.Kconfig"
source "components/pstar_managers/Kconfig.Kconfig"
source "components/pstar_error_handler/Kconfig.Kconfig"
source "components/pstar_pin_validator/Kconfig.Kconfig"
source "components/pstar_storage_hal/Kconfig.Kconfig"
```

## components/pstar_bus/Kconfig
```kconfig
# components/pstar_bus/Kconfig

menu "Project Star Bus Configuration"

    config PSTAR_KCONFIG_BUS_COMPONENT_ENABLED
        bool "Enable Bus Component"
        default y
        help
            Enable the Project Star Bus component, which provides a unified
            interface for different bus types.

    menu "Bus Type Configuration"
        depends on PSTAR_KCONFIG_BUS_COMPONENT_ENABLED

        config PSTAR_KCONFIG_BUS_I2C_ENABLED
            bool "Enable I2C Bus Support"
            default y
            help
                Enable I2C bus type support in the bus component.

        config PSTAR_KCONFIG_BUS_SPI_ENABLED
            bool "Enable SPI Bus Support"
            default y
            help
                Enable SPI bus type support in the bus component.

        config PSTAR_KCONFIG_BUS_UART_ENABLED
            bool "Enable UART Bus Support"
            default y
            help
                Enable UART bus type support in the bus component.

        config PSTAR_KCONFIG_BUS_GPIO_ENABLED
            bool "Enable GPIO Bus Support"
            default y
            help
                Enable GPIO bus type support in the bus component.

        config PSTAR_KCONFIG_BUS_SDIO_ENABLED
            bool "Enable SDIO Bus Support (for SD Cards in SDIO mode)"
            default y # Default to enabled if SD card might use it
            help
                Enable SDIO bus type support in the bus component.
                This is required if the Storage HAL is configured to use
                SD cards in SDIO (SDMMC) mode.
    endmenu

    menu "Bus Manager Configuration"
        depends on PSTAR_KCONFIG_BUS_COMPONENT_ENABLED

        config PSTAR_KCONFIG_BUS_MAX_BUSES
            int "Maximum number of buses"
            range 1 32
            default 10
            help
                Maximum number of buses that can be managed by the bus manager.

        config PSTAR_KCONFIG_BUS_MUTEX_TIMEOUT_MS
            int "Bus mutex timeout (ms)"
            range 10 10000
            default 1000
            help
                Timeout in milliseconds for acquiring bus mutexes.
    endmenu

endmenu
```

## components/pstar_error_handler/Kconfig
```kconfig
# components/pstar_error_handler/Kconfig

menu "Project Star: Error Handling Configuration"

    config PSTAR_KCONFIG_ERROR_HANDLER_ENABLED
        bool "Enable Error Handling Component"
        default y
        help
            Enable the Project Star Error Handling component, which provides
            a unified way to handle and recover from errors.
            
endmenu
```

## components/pstar_jtag/Kconfig
```kconfig
# components/pstar_jtag/Kconfig

menu "Project Star: JTAG Configuration"

    config PSTAR_KCONFIG_JTAG_ENABLED
        bool "Enable JTAG Support"
        default n
        help
            Enable JTAG debug support in the system. When enabled,
            JTAG-related pins can either be set to default values for
            the current MCU or defined manually via custom pin entries.

    choice
        prompt "JTAG Pin Configuration Mode"
        depends on PSTAR_KCONFIG_JTAG_ENABLED
        default PSTAR_KCONFIG_JTAG_USE_DEFAULT

        config PSTAR_KCONFIG_JTAG_USE_DEFAULT
            bool "Use default JTAG pin configuration for MCU"
            help
                Automatically apply the standard JTAG pinout based
                on the selected MCU (ESP32, ESP32-S2, ESP32-S3).

        config PSTAR_KCONFIG_JTAG_USE_CUSTOM
            bool "Use custom JTAG pin configuration"
            help
                Manually specify custom GPIO pins for each JTAG signal.

    endchoice

    choice
        prompt "Target MCU for default JTAG pin mapping"
        depends on PSTAR_KCONFIG_JTAG_ENABLED && PSTAR_KCONFIG_JTAG_USE_DEFAULT
        default PSTAR_KCONFIG_JTAG_MCU_ESP32

        config PSTAR_KCONFIG_JTAG_MCU_ESP32
            bool "ESP32 (Classic)"
            help
                Use default pin mapping for ESP32:
                TCK=GPIO13, TMS=GPIO14, TDI=GPIO12, TDO=GPIO15

        config PSTAR_KCONFIG_JTAG_MCU_ESP32S2
            bool "ESP32-S2"
            help
                Use default pin mapping for ESP32-S2:
                TCK=GPIO39, TMS=GPIO40, TDI=GPIO41, TDO=GPIO42

        config PSTAR_KCONFIG_JTAG_MCU_ESP32S3
            bool "ESP32-S3"
            help
                Use default pin mapping for ESP32-S3:
                TCK=GPIO39, TMS=GPIO40, TDI=GPIO41, TDO=GPIO42

    endchoice

    config PSTAR_KCONFIG_JTAG_PIN_TCK
        int "Custom GPIO for TCK (Test Clock)"
        depends on PSTAR_KCONFIG_JTAG_ENABLED && PSTAR_KCONFIG_JTAG_USE_CUSTOM
        range 0 39
        default 13
        help
            Specify the GPIO number to use for the TCK (clock) signal.

    config PSTAR_KCONFIG_JTAG_PIN_TMS
        int "Custom GPIO for TMS (Test Mode Select)"
        depends on PSTAR_KCONFIG_JTAG_ENABLED && PSTAR_KCONFIG_JTAG_USE_CUSTOM
        range 0 39
        default 14
        help
            Specify the GPIO number to use for the TMS signal.

    config PSTAR_KCONFIG_JTAG_PIN_TDI
        int "Custom GPIO for TDI (Test Data In)"
        depends on PSTAR_KCONFIG_JTAG_ENABLED && PSTAR_KCONFIG_JTAG_USE_CUSTOM
        range 0 39
        default 12
        help
            Specify the GPIO number to use for the TDI signal.

    config PSTAR_KCONFIG_JTAG_PIN_TDO
        int "Custom GPIO for TDO (Test Data Out)"
        depends on PSTAR_KCONFIG_JTAG_ENABLED && PSTAR_KCONFIG_JTAG_USE_CUSTOM
        range 0 39
        default 15
        help
            Specify the GPIO number to use for the TDO signal.

endmenu
```

## components/pstar_logger/Kconfig
```kconfig
# components/pstar_logger/Kconfig

menu "Project Star Logging Configuration"

    config PSTAR_KCONFIG_LOGGING_ENABLED
        bool "Enable Logging Component"
        default y
        help
            Enable the Project Star Logging component, which provides
            a unified way to log messages across the application.
            Note: All logging functions (log_info, log_error, etc.) are void functions
            and do not return error codes.

    menu "Log Level Configuration"
        depends on PSTAR_KCONFIG_LOGGING_ENABLED

        config PSTAR_KCONFIG_LOGGING_SD_CARD_ENABLED
            bool "Enable logging to SD card (Requires File Write Manager)"
            depends on PSTAR_KCONFIG_FILE_MANAGER_ENABLED
            default y
            help
                Enable logging to SD card via the File Write Manager.
                Requires the File Write Manager component to be enabled (which in turn
                requires SD Card support in the Storage HAL).

        choice PSTAR_KCONFIG_LOGGING_DEFAULT_LEVEL
            prompt "Default log level"
            default PSTAR_KCONFIG_LOGGING_LEVEL_INFO
            help
                Default log level for filtering messages.

            config PSTAR_KCONFIG_LOGGING_LEVEL_ERROR
                bool "Error"
            config PSTAR_KCONFIG_LOGGING_LEVEL_WARN
                bool "Warning"
            config PSTAR_KCONFIG_LOGGING_LEVEL_INFO
                bool "Info"
            config PSTAR_KCONFIG_LOGGING_LEVEL_DEBUG
                bool "Debug"
            config PSTAR_KCONFIG_LOGGING_LEVEL_VERBOSE
                bool "Verbose"
        endchoice

        config PSTAR_KCONFIG_LOGGING_CONSOLE_ENABLED
            bool "Enable logging to console"
            default y
            help
                Enable logging messages to the serial console.
    endmenu

    menu "Log Buffering Configuration"
        depends on PSTAR_KCONFIG_LOGGING_ENABLED

        config PSTAR_KCONFIG_LOGGING_BUFFER_SIZE
            int "Log buffer size (entries)"
            range 1 100
            default 50
            help
                Size of the buffer (in number of log entries) for storing logs temporarily,
                especially when SD card is unavailable or before storage is initialized.
    endmenu

    menu "SD Card Logging Configuration"
        depends on PSTAR_KCONFIG_LOGGING_ENABLED && PSTAR_KCONFIG_LOGGING_SD_CARD_ENABLED

        config PSTAR_KCONFIG_LOGGING_COMPRESSION_ENABLED
            bool "Enable log compression"
            depends on PSTAR_KCONFIG_SD_CARD_ENABLED
            default y
            help
                Enable compression of log files stored on SD card to save space.

        config PSTAR_KCONFIG_LOGGING_MAX_FILE_SIZE_KB
            int "Maximum log file size (KB)"
            range 64 10240
            default 1024
            help
                Maximum size of each log file in kilobytes before rotation occurs.

        config PSTAR_KCONFIG_LOGGING_BASE_DIR
            string "Log base directory"
            default "logs"
            help
                Base directory for storing log files on the SD card.

        config PSTAR_KCONFIG_LOGGING_COMPRESSION_BUFFER_SIZE
            int "Log compression buffer size"
            depends on PSTAR_KCONFIG_LOGGING_COMPRESSION_ENABLED && PSTAR_KCONFIG_SD_CARD_ENABLED
            range 1024 16384
            default 4096
            help
                Size of buffer used for compressing log data.

        config PSTAR_KCONFIG_LOGGING_COMPRESSED_EXTENSION
            string "Log compressed file extension"
            depends on PSTAR_KCONFIG_LOGGING_COMPRESSION_ENABLED && PSTAR_KCONFIG_SD_CARD_ENABLED
            default ".gz"
            help
                File extension for compressed log files.

        config PSTAR_KCONFIG_LOGGING_ZLIB_WINDOW_BITS
            int "Zlib window bits"
            depends on PSTAR_KCONFIG_LOGGING_COMPRESSION_ENABLED && PSTAR_KCONFIG_SD_CARD_ENABLED
            range 8 15
            default 15
            help
                Window bits parameter for zlib compression.

        config PSTAR_KCONFIG_LOGGING_ZLIB_MEM_LEVEL
            int "Zlib memory level"
            depends on PSTAR_KCONFIG_LOGGING_COMPRESSION_ENABLED && PSTAR_KCONFIG_SD_CARD_ENABLED
            range 1 9
            default 8
            help
                Memory level parameter for zlib compression.
    endmenu

    menu "Log Format Configuration"
        depends on PSTAR_KCONFIG_LOGGING_ENABLED

        config PSTAR_KCONFIG_LOGGING_MAX_MESSAGE_LENGTH
            int "Maximum log message length"
            range 64 1024
            default 256
            help
                Maximum length of log message text.

        config PSTAR_KCONFIG_LOGGING_MAX_TAG_LENGTH
            int "Maximum tag length"
            range 16 64
            default 32
            help
                Maximum length of log tag string.

        config PSTAR_KCONFIG_LOGGING_SEPARATOR
            string "Log message separator"
            default " - "
            help
                Separator string between short message and detailed message.

        config PSTAR_KCONFIG_LOGGING_TASK_NAME_LENGTH
            int "Maximum task name length"
            range 8 32
            default 16
            help
                Maximum length of task name in log messages.

        config PSTAR_KCONFIG_LOGGING_TIMESTAMP_BUFFER_SIZE
            int "Timestamp buffer size"
            range 32 128
            default 64
            help
                Size of buffer for timestamp strings.

        config PSTAR_KCONFIG_LOGGING_DATE_STRING_BUFFER_SIZE
            int "Date string buffer size"
            range 16 64
            default 32
            help
                Size of buffer for date strings.

        config PSTAR_KCONFIG_LOGGING_INCLUDE_TIMESTAMP
            bool "Include timestamp in log messages"
            depends on PSTAR_KCONFIG_TIME_MANAGER_ENABLED
            default y
            help
                Include timestamp in each log message.

        config PSTAR_KCONFIG_LOGGING_INCLUDE_TASK_INFO
            bool "Include task information in log messages"
            default y
            help
                Include task name and handle in each log message.
    endmenu

endmenu
```
